## conf/distro/nonlinear-nuc-distro.conf
```bitbake
DISTRO = "nonlinear-nuc-distro"
DISTRO_NAME = "Nonlinear-Labs NUC Linux Distribution"
DISTRO_BUILD_ID ?= "devel"
DISTRO_VERSION ?= "${DISTRO_BUILD_ID}"
DISTRO_CODENAME = "cane"
SDK_VENDOR = "-nonlinearsdk"
SDK_VERSION := "${@'${DISTRO_VERSION}'.replace('snapshot-${DATE}','snapshot')}"
SDK_NAME = "${DISTRO}-${TCLIBC}-${SDK_ARCH}-${IMAGE_BASENAME}-${TUNE_PKGARCH}"
SDKPATH = "/opt/${DISTRO}/${SDK_VERSION}"

MAINTAINER = "Pascal Huerst <pascal.huerst@gmail.com>"

TARGET_VENDOR = "-nonlinear"

LOCALCONF_VERSION = "1"

DISTRO_VERSION[vardepsexclude] = "DATE"
SDK_VERSION[vardepsexclude] = "DATE"

DISTRO_FEATURES = "\
  ${DISTRO_FEATURES_LIBC} \
  largefile \
  systemd \
  pam \
  "

DISTRO_FEATURES_remove = "opkg-utils"
DISTRO_FEATURES_remove = "x11"

VIRTUAL-RUNTIME_init_manager = "systemd"
DISTRO_FEATURES_BACKFILL_CONSIDERED = "sysvinit"
VIRTUAL-RUNTIME_initscripts = ""

LICENSE_FLAGS_WHITELIST += " commercial"

PACKAGECONFIG_remove_pn-systemd = "importd polkit cryptsetup resolved machined hostnamed microhttpd quotacheck localed firstboot audit rkfill"

IMAGE_BOOT_FILES = ""

# add poky sanity bbclass
SANITY_TESTED_DISTROS ?= " \
            Fedora-25 \n \
            "
INHERIT += "poky-sanity"

# QA check settings - a little stricter than the OE-Core defaults
WARN_TO_ERROR_QA = "already-stripped compile-host-path install-host-path \
                    installed-vs-shipped ldflags pn-overrides rpaths staticdev \
                    useless-rpaths"
WARN_QA_remove = "${WARN_TO_ERROR_QA}"
ERROR_QA_append = " ${WARN_TO_ERROR_QA}"

require conf/distro/include/poky-world-exclude.inc
require conf/distro/include/no-static-libs.inc
```
